## esp32/arduino/remote_control/sdkconfig.defaults
```kconfig
CONFIG_GATTC_MAX_CONNECTIONS=2
CONFIG_BT_ACL_CONNECTIONS=4
CONFIG_BT_CLASSIC_ENABLED=y
CONFIG_BT_SPP_ENABLED=y
CONFIG_BTDM_CTRL_MODE_BTDM=y
```
